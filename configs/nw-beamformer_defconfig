## configs/nw-beamformer_defconfig
```kconfig
CONFIG_ARM=y
CONFIG_COUNTER_FREQUENCY=400000000
CONFIG_SPL_LDSCRIPT="arch/arm/mach-socfpga/u-boot-spl-soc64.lds"
CONFIG_ARCH_SOCFPGA=y
CONFIG_TEXT_BASE=0x200000
CONFIG_SYS_MALLOC_F_LEN=0x2000
CONFIG_NR_DRAM_BANKS=2
CONFIG_ENV_SIZE=0x2000
CONFIG_ENV_OFFSET=0x04100000
CONFIG_ENV_SECT_SIZE=0x20000
CONFIG_SYS_SPI_U_BOOT_OFFS=0x04000000
CONFIG_DM_GPIO=y
CONFIG_DEFAULT_DEVICE_TREE="socfpga_stratix10_socdk"
CONFIG_SPL_TEXT_BASE=0xFFE00000
CONFIG_TARGET_SOCFPGA_STRATIX10_SOCDK=y
CONFIG_IDENT_STRING="socfpga_stratix10"
CONFIG_SPL_FS_FAT=y
CONFIG_DISTRO_DEFAULTS=y
CONFIG_FIT=y
CONFIG_SPL_FIT_SIGNATURE=y
CONFIG_SPL_LOAD_FIT=y
CONFIG_SPL_LOAD_FIT_ADDRESS=0x02000000
# CONFIG_USE_SPL_FIT_GENERATOR is not set
# CONFIG_SPL_RAW_IMAGE_SUPPORT is not set
CONFIG_HAS_CUSTOM_SYS_INIT_SP_ADDR=y
CONFIG_CUSTOM_SYS_INIT_SP_ADDR=0x300000
CONFIG_SPL_MAX_SIZE=0x40000
CONFIG_SPL_HAS_BSS_LINKER_SECTION=y
CONFIG_SPL_BSS_START_ADDR=0x3ff00000
# CONFIG_SPL_SHARES_INIT_SP_ADDR is not set
CONFIG_SPL_STACK=0xffe3f000
CONFIG_SPL_SYS_MALLOC=y
CONFIG_SPL_HAS_CUSTOM_MALLOC_START=y
CONFIG_SPL_CUSTOM_SYS_MALLOC_ADDR=0x3fa00000
CONFIG_SPL_SYS_MALLOC_SIZE=0x500000
CONFIG_SPL_BSS_MAX_SIZE=0x100000
CONFIG_SPL_CRC32=y
CONFIG_SPL_MTD_SUPPORT=y
CONFIG_SPL_SPI_LOAD=y
CONFIG_SPL_YMODEM_SUPPORT=y
CONFIG_SPL_ATF=y
CONFIG_SPL_ATF_NO_PLATFORM_PARAM=y
CONFIG_CMD_NVEDIT_SELECT=y
CONFIG_CMD_MEMTEST=y
# CONFIG_CMD_FLASH is not set
CONFIG_CMD_GPIO=y
CONFIG_CMD_I2C=y
CONFIG_CMD_MMC=y
CONFIG_CMD_MTD=y
CONFIG_CMD_SPI=y
CONFIG_CMD_USB=n
CONFIG_CMD_CACHE=y
CONFIG_SPL_SPI_FLASH_MTD=y
CONFIG_SPI_FLASH_MTD=y
# CONFIG_SPI_FLASH_USE_4K_SECTORS is not set
CONFIG_CMD_UBI=y
CONFIG_CMD_UBIFS=y
CONFIG_MTD_UBI=y
CONFIG_MTD_UBI_WL_THRESHOLD=4096
CONFIG_MTD_UBI_BEB_LIMIT=20
# CONFIG_ISO_PARTITION is not set
# CONFIG_EFI_PARTITION is not set
CONFIG_OF_LIST=""
CONFIG_ENV_IS_IN_FAT=n
CONFIG_SYS_RELOC_GD_ENV_ADDR=y
CONFIG_NET_RANDOM_ETHADDR=y
CONFIG_SPL_DM_SEQ_ALIAS=y
CONFIG_SPL_ALTERA_SDRAM=y
CONFIG_FPGA_INTEL_PR=y
CONFIG_DWAPB_GPIO=y
CONFIG_DM_I2C=y
CONFIG_SYS_I2C_DW=y
CONFIG_MISC=y
CONFIG_MMC_DW=y
CONFIG_SYS_MMC_MAX_BLK_COUNT=256
CONFIG_MTD=y
CONFIG_DM_MTD=y
CONFIG_SYS_NAND_U_BOOT_LOCATIONS=y
CONFIG_SYS_NAND_U_BOOT_OFFS=0x0
CONFIG_SYS_NAND_U_BOOT_OFFS_REDUND=0x100000
CONFIG_SF_DEFAULT_MODE=0x2003
CONFIG_SPI_FLASH_SPANSION=y
CONFIG_SPI_FLASH_STMICRO=y
CONFIG_PHY_MICREL=y
CONFIG_PHY_MICREL_KSZ90X1=y
CONFIG_DM_ETH=y
CONFIG_ETH_DESIGNWARE=y
CONFIG_MII=y
CONFIG_DM_RESET=y
CONFIG_SYS_NS16550_MEM32=y
CONFIG_SPI=y
CONFIG_CADENCE_QSPI=y
CONFIG_DESIGNWARE_SPI=y
CONFIG_USB=n
CONFIG_DM_USB=y
CONFIG_USB_DWC2=y
CONFIG_DESIGNWARE_WATCHDOG=y
CONFIG_WDT=y
# CONFIG_SPL_USE_TINY_PRINTF is not set
CONFIG_PANIC_HANG=y


# Boot support
CONFIG_BOOTFILE="Image"
CONFIG_BOOTCOMMAND="bridge enable ; dhcp ; bootm"
CONFIG_QSPI_BOOT=y
CONFIG_BOOTDELAY=5
CONFIG_USE_BOOTARGS=y
CONFIG_HUSH_PARSER=y
CONFIG_USE_BOOTCOMMAND=y
CONFIG_BOOTARGS="earlycon panic=-1 initrd=initrd console=ttyS1,115200 loglevel=4"


# Disable support for NAND
CONFIG_NAND_BOOT=n
CONFIG_SPL_NAND_SUPPORT=n
CONFIG_CMD_NAND_TRIMFFS=n
CONFIG_CMD_NAND_LOCK_UNLOCK=n
CONFIG_NAND_DENALI_DT=n
CONFIG_SYS_NAND_U_BOOT_LOCATIONS=n
CONFIG_SPL_NAND_FRAMEWORK=n
CONFIG_CMD_NAND=n
CONFIG_MTD_RAW_NAND=n

# Customize our prompt
CONFIG_SYS_PROMPT="Beamformer UBoot λ "
CONFIG_SYS_PROMPT_HUSH_PS2="> "

# Useful debugging
CONFIG_CMD_DHCP=y
CONFIG_CMD_WGET=y
CONFIG_CMD_DNS=n

# Load over serial
CONFIG_CMD_LOADB=y

CONFIG_LZO=y

# Ethernet Phy Configuration
CONFIG_DM_ETH_PHY=y
CONFIG_DM_MDIO=y

# Enable extra flash devices
CONFIG_SPI_FLASH_MACRONIX=y
CONFIG_SPI_FLASH_GIGADEVICE=y
CONFIG_SPI_FLASH_WINBOND=y

# Enable secure monitor call
# this is used to grab the chip id
CONFIG_CMD_SMC=y

# Enable our custom shit because we're sick.
CONFIG_CMD_NORTHWOOD=y

# Enable Power On Self Test (POST)
#
# This is broken do not enable.
CONFIG_POST=n

# UBoot env setup
#
# we are storing our u-boot environment in qspi
CONFIG_ENV_IS_IN_SPI_FLASH=y
CONFIG_ENV_UBI_PART="u-boot"
CONFIG_ENV_UBI_VOLUME="env"
# check the device: from the output of
# Beamformer UBoot λ mtd list
# - parent: spi@ff8d2000
# - driver: jedec_spi_nor
# - path: /soc/spi@ff8d2000/flash@0
# - type: NOR flash
# - block size: 0x10000 bytes
# - min I/O: 0x1 bytes
# - 0x000000000000-0x000010000000 : "nor0"
#         - 0x000000000000-0x000002800000 : "u-boot"
CONFIG_MTDIDS_DEFAULT="nor0=flash@0"
CONFIG_MTDPARTS_DEFAULT="mtdparts=flash@0:40m(u-boot)"
CONFIG_ENV_OVERWRITE=y
```
